#include <LiquidCrystal.h> 
#include <Keypad.h> 
#include<Stepper.h>
#include <PCM.h>
#include <SoftwareSerial.h>

/* Select digital pins of Arduino Mega */
#define redLED 45 
#define greenLED 37
#define buzzer 49
#define blueled 53
#define testled 51
#define motorpin1 25
#define motorpin2 27
#define motorpin3 29
#define motorpin4 31
#define STEPS 64

/*Declare strings for PCM voice file */
const unsigned char enterpassword[] PROGMEM = {
130, 128, 126, 128, 127, 126, 126, 128, 127, 127, 128, 128,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 128, };

const unsigned char verified[] PROGMEM = {
129, 129, 129, 130, 130, 131, 130, 130, 130, 130, 129, 127,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 127, };

const unsigned char tryagain[] PROGMEM = {
126, 127, 128, 127, 128, 128, 127, 128, 127, 128, 128, 128,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 127, };


/*Declare object of Stepper class for using stepper motor */
Stepper small_stepper(STEPS,motorpin1,motorpin3,motorpin2,motorpin4);
int Steps2Take;


/*int RECV_PIN = 26; // the pin where you connect the output pin of sensor
IRrecv irrecv(RECV_PIN);
decode_results results;
unsigned long key_value = 0;*/


/*Declare global variables */
char epassword[8];
char password[] = "5678";
bool alarmstate=false;
int pos=0;
int curpos=0;
int lockstate=0;
int Num_Of_Attempts=3;
bool match=false;
char whichKey;
char stat[2];

/*Configure keypad buttons */
const byte rows = 4; //number of the keypad's rows and columns
const byte cols = 4;

char keyMap [rows] [cols] = { //define the symbols on the buttons of the keypad

  {'1', '2', '3', 'A'},
  {'4', '5', '6', 'B'},
  {'7', '8', '9', 'C'},
  {'*', '0', '#', 'D'}
};

byte rowPins [rows] = {1, 2, 3, 4}; //pins of the keypad
byte colPins [cols] = {5, 6, 7, 8};

Keypad myKeypad = Keypad( makeKeymap(keyMap), rowPins, colPins, rows, cols);


/*Select Analog pins from Arduino Mega for LCD screen */
LiquidCrystal lcd (A0, A1, A2, A3, A4, A5); // pins of the LCD. (RS, E, D4, D5, D6, D7)

void setup(){

	/*Set the baud rate of TX0 and RX0 pin of Arduino Mega to 9600 */
	Serial.begin(9600); 
	/*Set the baud rate of TX2 and RX2 pin of Arduino Mega to 9600 */
	Serial2.begin(9600);
  
	delay(2000);

	lcd.setCursor(0, 0);
	lcd.print(" Enter Password");
  
	/*Voice output for "Enter Password"*/
	startPlayback(enterpassword, sizeof(enterpassword)); 
	delay(1000);
	stopPlayback();
  

	/*set the speed of the stepper motor*/
	small_stepper.setSpeed(400);  


	lcd.begin(16, 2);
	pinMode(redLED, OUTPUT);  
	pinMode(greenLED, OUTPUT);
	pinMode(buzzer, OUTPUT);
	pinMode(blueled, OUTPUT);
  
	setLocked (true); 
  
}

/*Custom function to reset the system*/
void reset()
{
	Num_Of_Attempts=3;
	alarmstate=false;
	pos=0;
	curpos=0;
	lockstate=0;
	Num_Of_Attempts=3;
	match=false;
	lcd.clear();
    lcd.setCursor(0, 0);
    empty(epassword);
    whichKey='\0';

    digitalWrite(buzzer,LOW);
    digitalWrite(blueled,LOW);   
  
}

void loop(){

	/*Send system state to ESP8266 Wifi module*/
	if(millis() % 10 ==0)
	{
	  if(lockstate==0 && alarmstate==false)
	  {
		Serial2.write("11");

	  }
	  else if(lockstate==1 && alarmstate==false)
	  {
		Serial2.write("01");
	  }
	  else if(lockstate==0 && alarmstate==true)
	  {
		Serial2.write("10");

	  }
	  
	}
	 
	 /*Receive data from ESP8266 Wifi module*/
	 String IncomingString="";
	 boolean StringReady = false;

	 while (Serial2.available()){
	   IncomingString=Serial2.readString();
	   StringReady= true;
	  }
	 
	 /*print received data from ESP8266 Wifi module to the serial monitor for testing*/
	 if (StringReady)
	  {
		Serial.println("Received String: " + IncomingString);
	  
	  }

	/*Trigger actions after receiving data from ESP8266 Wifi module*/
	if(IncomingString.substring(0,10)=="open" && lockstate==0)
	{
		  
		whichKey= '*';
		lockstate=1;

		
		lcd.clear();
		lcd.setCursor(0, 0);
		lcd.print("*** Verified ***");

		setLocked(0);
		  
		startPlayback(verified, sizeof(verified));
		delay(1000);
		stopPlayback();
		  
		Serial.println("OPEN DOOR...!!!");
		small_stepper.setSpeed(500);
		Steps2Take= 1024;
		small_stepper.step(Steps2Take);
		
		lcd.clear();
		lcd.setCursor(0, 0);
		lcd.print("Door is Open");
		lcd.setCursor(0, 1);
		lcd.print("Lock--> *");

		
	}

	if(IncomingString.substring(0,10)=="close" && lockstate==1)
	{
		reset();
		Serial.println("CLOSE DOOR...!!!");
		small_stepper.setSpeed(500);
		Steps2Take= -1024;
		small_stepper.step(Steps2Take);
		setLocked(1);
		lcd.clear();
		lcd.setCursor(0, 0);
		lcd.print(" Enter Password");
		startPlayback(enterpassword, sizeof(enterpassword));
		delay(1000);
		stopPlayback();
	}

	if(IncomingString.substring(0,10)=="buzz" && alarmstate==true)
	{
		Serial.println("Turn OFF Buzzer...!!!");
		lcd.clear();
		lcd.setCursor(0, 0);
		lcd.print(" Enter Password");
		startPlayback(enterpassword, sizeof(enterpassword));
		delay(1000);
		stopPlayback();
		digitalWrite(buzzer,LOW);
		digitalWrite(blueled,LOW);
		reset();
	}


	if(Num_Of_Attempts==0 && alarmstate==false)
	{
		lcd.clear();
		lcd.setCursor(0, 0);
		lcd.print("Exceeded");
		alarmstate=true;
	}

	if(alarmstate==true && lockstate==0)
	{
		digitalWrite(buzzer,HIGH);
		digitalWrite(blueled,HIGH);
	} 
	 

	if(lockstate==0 && Num_Of_Attempts>0)
	{
		lcd.setCursor(0, 0);
		lcd.print(" Enter Password");
		match=false;
	}

	/*Read which key is pressed with getKey*/
	whichKey = myKeypad.getKey(); 

	if(whichKey == '*' && lockstate==1 )
	{
	 
		lcd.clear();
		lcd.setCursor(0, 0);
		lcd.print("*** Door Locked ***");
		setLocked (true);
		small_stepper.setSpeed(500);
		Steps2Take= -1024;
		small_stepper.step(Steps2Take);
		delay(2000);
		reset();
		delay(2000);
		startPlayback(enterpassword, sizeof(enterpassword));
		delay(1000);
		stopPlayback();
	 }
	if(whichKey == 'D' && Num_Of_Attempts>0)
	{
	 
		Num_Of_Attempts--;

		for(int i=0;password[i]!='\0';i++)
		{
			if(password[i]==epassword[i] && pos<5)
			{
				match=true;
			}
			else
			{
				match=false;
			}
		}

		if(match)
		{
			setLocked (false);
			lockstate=1;
			lcd.clear();
			lcd.setCursor(0, 0);
			lcd.print("*** Verified ***");

			startPlayback(verified, sizeof(verified));
			delay(1000);
			stopPlayback();
			delay(500);

			small_stepper.setSpeed(500);
			Steps2Take= 1024;
			small_stepper.step(Steps2Take);
			delay(2000);

			lcd.clear();
			lcd.setCursor(0, 0);
			lcd.print("Door is Open");
			lcd.setCursor(0, 1);
			lcd.print("Lock--> *");
			delay(500);
		}
		else
		{
			pos=0;
			curpos=0;
			empty(epassword);
			lcd.clear();
			lcd.setCursor(0, 0);
			setLocked (true);
			lcd.clear();
			lcd.setCursor(0, 0);
			lcd.print("  Wrong Password!");
			delay(800);

			startPlayback(tryagain, sizeof(tryagain));
			delay(1000);
			stopPlayback();
	  
			lcd.clear();
			lcd.setCursor(0, 0);
			lcd.print("Left: ");
			lcd.print(Num_Of_Attempts);
			delay(800);
		
			lcd.clear();

			if(Num_Of_Attempts > 0)
			{
				startPlayback(enterpassword, sizeof(enterpassword));
				delay(1000);
				stopPlayback();
			}
		}
		
		
	}

	if(whichKey != 'D' && whichKey != '*' && whichKey != '\0')
	{
		epassword[pos]=whichKey;
		lcd.setCursor(curpos,1);
		lcd.print("*");
		curpos++;
		pos++;
	}

  delay(100);
}


void setLocked(int locked)
{
  if(locked)
  {
	digitalWrite(redLED, HIGH);
    digitalWrite(greenLED, LOW);
  }
  else
  {
    digitalWrite(redLED, LOW);
    digitalWrite(greenLED, HIGH);
  }
}

void empty(char epassword[])
{
  for(int i=0;epassword[i]!='\0';i++)
  {
    epassword[i]='\0';
  }
}
